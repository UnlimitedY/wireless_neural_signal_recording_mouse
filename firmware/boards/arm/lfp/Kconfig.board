## firmware/boards/arm/lfp/Kconfig.board
```kconfig
config BOARD_LFP
	bool "Custom Board auto generated by nRF Connect for VS Code"
	depends on SOC_NRF52840_QIAA
```

## firmware/boards/arm/lfp/Kconfig.defconfig
```kconfig
if BOARD_LFP

config BOARD
	default "lfp"

config BT_CTLR
	default BT

endif # BOARD_LFP
```
